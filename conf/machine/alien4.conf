## conf/machine/alien4.conf
```bitbake
#@TYPE: Machine
#@NAME: 
#@DESCRIPTION: Machine configuration for the Amiko Alien4

SOC_FAMILY = "AML905"

require conf/machine/include/mecool.inc

KERNEL_DEVICETREE = "gxbb_p200_alien4.dtb"


MACHINE_ESSENTIAL_EXTRA_RDEPENDS += "\
	rtl8189es-aml \
	linkdroid-dvb-modules-alien5 \
	linkdroid-extra-alien5 \
	"


KERNEL_MODULE_AUTOLOAD += "\
	8189es \
	"
```

## conf/machine/c300.conf
```bitbake
#@TYPE: Machine
#@NAME: Magicsee c300 (S905D SoC)
#@DESCRIPTION: Machine configuration for the Magicsee c300

SOC_FAMILY = "AML905D"

require conf/machine/include/mecool.inc

KERNEL_DEVICETREE = "gxl_p231_c300.dtb"
```

## conf/machine/c300pro.conf
```bitbake
#@TYPE: Machine
#@NAME: Magicsee c300 pro (Amlogic S912 SoC)
#@DESCRIPTION: Machine configuration for the Magicsee c300 pro

SOC_FAMILY = "AML912D"

require conf/machine/include/mecool.inc

KERNEL_DEVICETREE = "gxm_q201_c300_pro.dtb"
```

## conf/machine/c400plus.conf
```bitbake
#@TYPE: Machine
#@NAME: Magicsee c400 plus (Amlogic S912 SoC)
#@DESCRIPTION: Machine configuration for the Magicsee c400 plus

SOC_FAMILY = "AML912D"

require conf/machine/include/mecool.inc

KERNEL_DEVICETREE = "gxm_q201_3g_c400_plus"
```

## conf/machine/include/linkdroid.inc
```bitbake
BOX_BRAND = "linkdroid"

KERNEL_FILE = "kernel.itb"
ROOTFS_FILE = "rootfs.tar.bz2"

PREFERRED_PROVIDER_virtual/kernel = "linux-linkdroid"
PREFERRED_VERSION_linux-linkdroid = "3.14.29"

MACHINEKERNEL = "linkdroid"

# Amlogic defaults
require conf/machine/include/arm/arch-armv8.inc
require conf/machine/include/soc-family.inc

IMAGE_CLASSES += "sdcard_image-amlogic"
SDCARD_ROOTFS ?= "${DEPLOY_DIR_IMAGE}/${IMAGE_NAME}.rootfs.ext4"
IMAGE_FSTYPES ?= "amlogicsdimg"
IMAGE_ROOTFS_SIZE = "476562"
IMAGE_EXTRA_SPACE = "0"
IMAGE_OVERHEAD_FACTOR = "1.0"

BB_HASH_IGNORE_MISMATCH = "1"

# Serial console to be used
SERIAL_CONSOLE = "115200 ttyS0"

KERNEL_CLASSES += "aarch64-fitimage"
KERNEL_IMAGETYPE = "fitImage"

UBOOT_ENTRYPOINT = "0x01080000"
UBOOT_LOADADDRESS = "0x01080000"

INITRAMFS_IMAGE = "amlogic-initramfs"

MACHINE_FEATURES = "bluetooth usbhost vfat alsa dvb-c nolcd hdmicec fb emmc linkdroid-pli nogamma"

DVBPROVIDER = "kernel"
DVBSKYPROVIDER = "kernel"

MACHINE_ESSENTIAL_EXTRA_RDEPENDS += "\
    amlogic-autoscript \
    linkdroid-mali-alien5 \
    linkdroid-gst-amlavsink1 \
    linkdroid-libamplayer-alien5 \
    linkdroid-libamavutils-alien5 \
    linkdroid-libamadec-alien5 \
    linkdroid-libamcodec-alien5 \
    kernel-modules \
    amremote \
    linkdroid-dvb-modules-alien5 \
    linkdroid-libavlib-audio-so-alien5 \
    libmad \
    linkdroid-extra-alien5 \
    linkdroid-amlsetfb \
    "
	
KERNEL_MODULE_AUTOLOAD += "\
    se2io_se \
    ampanel \
    a5stb \
    mali \
    rfcomm \
    hidp \
    bluetooth \
    6lowpan-iphc \
    libcrc32c \
    mceusb \
    rc-core \
    cfg80211 \
    8189es \
"

### TODO:     8189es builitin with cfg80211
MACHINE_ESSENTIAL_EXTRA_RRECOMMENDS += "\
    kernel-module-cdfs \
    kernel-module-sysfillrect \
    kernel-module-syscopyarea \
    kernel-module-mceusb \
    kernel-module-rc-core \
    kernel-module-CH341 \
    kernel-module-rfcomm \
    kernel-module-hidp \
    kernel-module-bluetooth \
    kernel-module-6lowpan-iphc \
    kernel-module-libcrc32c \
    kernel-module-xfs \
    kernel-module-8189es \
    kernel-module-cfg80211 \
    "

MACHINE_EXTRA_RRECOMMENDS += "\
    linkdroid-lkdosth \
    amlogic-cnim \
    "

PREFERRED_PROVIDER_jpeg = "libjpeg-turbo"
PREFERRED_PROVIDER_jpeg-native = "libjpeg-turbo-native"

EXTRA_OECONF_append_pn-enigma2 = " --with-alsa --with-alsacard=hw:0 --with-alsamixer=Master --with-fbdev=/dev/fb0 --with-lcddev=/dev/null --with-amlogic"
DEPENDS_append_pn-enigma2 = " libdvbcsa linkdroid-libamcodec-alien5 linkdroid-libamadec-alien5 gstreamer1.0 gstreamer1.0-plugins-base "
EXTRA_OECONF_append_pn-tuxtxt-enigma2 = " --with-fbdev=/dev/fb0"
DEPENDS_append_pn-enigma2-plugin-systemplugins-servicemp3 = " linkdroid-libamcodec-alien5 "
CC_append_pn-showiframe = " -DHAVE_AMLOGIC -I${STAGING_INCDIR}/amlogic/amcodec -lamcodec -lgstpbutils-1.0 -lgstreamer-1.0 -lgobject-2.0 -lglib-2.0"
DEPENDS_append_pn-showiframe = " linkdroid-libamcodec-alien5 gstreamer1.0 gstreamer1.0-libav gstreamer1.0-plugins-base gstreamer1.0-plugins-good gstreamer1.0-plugins-ugly"

DISTRO_FEATURES_remove = "x11 wayland"

IMAGEDIR ?= "${MACHINE}"

IMAGE_CMD_amlogicsdimg_append = "\
    mkdir -p ${DEPLOY_DIR_IMAGE}/${IMAGEDIR}; \
    mv ${DEPLOY_DIR_IMAGE}/${IMAGE_NAME}.img ${DEPLOY_DIR_IMAGE}/${IMAGEDIR}/${IMAGE_NAME}.img; \
    echo ${DISTRO_NAME}-${DISTRO_VERSION}.${BUILD_VERSION} > ${DEPLOY_DIR_IMAGE}/${IMAGEDIR}/imageversion; \
    cd ${DEPLOY_DIR_IMAGE}; \
    zip ${IMAGE_NAME}_sdcard.zip ${IMAGEDIR}/*; \
    rm -f ${DEPLOY_DIR_IMAGE}/*.ext4; \
    rm -f ${DEPLOY_DIR_IMAGE}/*.manifest; \
    rm -f ${DEPLOY_DIR_IMAGE}/*.json; \
    rm -f ${DEPLOY_DIR_IMAGE}/*.img; \
    rm -Rf ${IMAGEDIR}; \
    "

# We know about rtc
include conf/machine/include/build-extras.inc
```

## conf/machine/k1plus.conf
```bitbake
#@TYPE: Machine
#@NAME: 
#@DESCRIPTION: Machine configuration for the Mecool K1 Plus

SOC_FAMILY = "AML905"

require conf/machine/include/mecool.inc

KERNEL_DEVICETREE = "gxbb_p200_k1_plus.dtb"


MACHINE_ESSENTIAL_EXTRA_RDEPENDS += "\
	rtl8189es-aml \
	"


KERNEL_MODULE_AUTOLOAD += "\
	8189es \
	"
```

## conf/machine/k1pro.conf
```bitbake
#@TYPE: Machine
#@NAME: 
#@DESCRIPTION: Machine configuration for the Mecool K1 Pro

SOC_FAMILY = "AML905D"

require conf/machine/include/mecool.inc

KERNEL_DEVICETREE = "gxl_p230_k1_pro.dtb"
```

## conf/machine/k2pro.conf
```bitbake
#@TYPE: Machine
#@NAME: Mecool K2 Pro (S905 SoC)
#@DESCRIPTION: Machine configuration for the Mecool K2 Pro (Old version)

SOC_FAMILY = "AML905"

require conf/machine/include/mecool.inc

KERNEL_DEVICETREE = "gxbb_p200_k2_pro.dtb"

MACHINE_ESSENTIAL_EXTRA_RDEPENDS += "\
	mecool-dvb-modules-e2procfs \
	"
```

## conf/machine/k2prov2.conf
```bitbake
#@TYPE: Machine
#@NAME: Mecool K2 Pro (S905D SoC)
#@DESCRIPTION: Machine configuration for the Mecool K2 Pro (New version)

SOC_FAMILY = "AML905D"

require conf/machine/include/mecool.inc

KERNEL_DEVICETREE = "gxl_p231_2g_dvb"
```

## conf/machine/k3pro.conf
```bitbake
#@TYPE: Machine
#@NAME: 
#@DESCRIPTION: Machine configuration for the Mecool K3 Pro

SOC_FAMILY = "AML912"

require conf/machine/include/mecool.inc

KERNEL_DEVICETREE = "gxm_q200_k3_pro.dtb"
```

## conf/machine/kvim2.conf
```bitbake
#@TYPE: Machine
#@NAME: Khadas Vim2 (S905D SoC)
#@DESCRIPTION: Machine configuration for the Khadas Vim2

SOC_FAMILY = "AML905D"

require conf/machine/include/mecool.inc

KERNEL_DEVICETREE = "gxm_kvim2.dtb"
```
